## Firmware/Kconfig
```kconfig
config IRONHAND_TARKOV_DISPLAY
    bool "Show Tarkov splash image behind ZMK display widgets"
    depends on ZMK_DISPLAY
    default n

config IRONHAND_TARKOV_DISPLAY_INIT_PRIORITY
    int "Init priority for the Tarkov image widget (must be > ZMK display init)"
    depends on IRONHAND_TARKOV_DISPLAY
    default 99
```

## Firmware/boards/shields/Evert/Kconfig.shield
```kconfig
config SHIELD_EVERT
    def_bool $(shields_list_contains,Evert)
    
config SHIELD_EVERT
    depends on SOC_NRF52840_QIAA
```

## dts/bindings/gpio/microchip,mcp23s17.yaml
```yaml
description: Microchip MCP23S17 SPI 16-bit I/O expander

compatible: "microchip,mcp23s17"

include: [gpio-controller.yaml, spi-device.yaml]

properties:
  reset-gpios:
    type: phandle-array
    description: Reset GPIO pin (active low)
  int-gpios:
    type: phandle-array
    description: Interrupt GPIO pin(s)

gpio-cells:
  - pin
  - flags
```
